## zephyr/arch/riscv64/defconfig
```kconfig
CONFIG_RISCV64=y
CONFIG_SYS_CLOCK_HW_CYCLES_PER_SEC=60000000
CONFIG_RISCV_SYSTIMER=y
```

## zephyr/arch/riscv64/soc/riscv_gnss/Kconfig.defconfig
```kconfig
# Kconfig - Atmel SAM3 family processor configuration options

#
# Copyright (c) 2016 Intel Corporation.
# Copyright (c) 2014-2015 Wind River Systems, Inc.
#
# Licensed under the Apache License, Version 2.0 (the "License");
# you may not use this file except in compliance with the License.
# You may obtain a copy of the License at
#
#     http://www.apache.org/licenses/LICENSE-2.0
#
# Unless required by applicable law or agreed to in writing, software
# distributed under the License is distributed on an "AS IS" BASIS,
# WITHOUT WARRANTIES OR CONDITIONS OF ANY KIND, either express or implied.
# See the License for the specific language governing permissions and
# limitations under the License.
#

if SOC_RISCV_GNSS

config SOC
	default riscv_gnss

config NUM_IRQS
	int
	default 5

config SYS_CLOCK_HW_CYCLES_PER_SEC
	int
	default 60000000

#
# SRAM address depends on the SoC generic parameters.
#
config SRAM_SIZE
	default 512 if SOC_RISCV_GNSS

config SRAM_BASE_ADDRESS
	default 0x10000000


endif # SOC_RISCV_GNSS
```

## zephyr/arch/riscv64/soc/riscv_gnss/Kconfig.soc
```kconfig
config SOC_RISCV_GNSS
	bool "RISC-V SOC by Gnss Sensor Ltd"
	help
	Synthezable SoC based on open ISA RISC-V.
```

## zephyr/boards/riscv_gnss/Kconfig.board
```kconfig
config  BOARD_RISCV_GNSS
        bool "RISC-V based FPGA SoC"
        depends on SOC_RISCV_GNSS
	help
	The RISC-v VHDL FPGA development boards
```

## zephyr/boards/riscv_gnss/Kconfig.defconfig
```kconfig
if BOARD_RISCV_GNSS

config BOARD
        default riscv_gnss


endif # BOARD_RISCV_GNSS
```

## zephyr/boards/riscv_gnss/riscv_gnss_defconfig
```kconfig
CONFIG_RISCV64=y
CONFIG_SOC_RISCV_GNSS=y
CONFIG_BOARD_RISCV_GNSS=y
CONFIG_PRINTK=y
CONFIG_SERIAL=y
CONFIG_CONSOLE=y
CONFIG_UART_CONSOLE=y
CONFIG_STDOUT_CONSOLE=y
CONFIG_SYS_CLOCK_EXISTS=y
CONFIG_SYS_CLOCK_HW_CYCLES_PER_SEC=60000000
CONFIG_SYS_CLOCK_TICKS_PER_SEC=100
CONFIG_UART_RISCV_GNSS=y
CONFIG_RISCV_SYSTIMER=y
CONFIG_NANO_TIMERS=y
CONFIG_NANO_TIMEOUTS=y
CONFIG_MAIN_STACK_SIZE=16384
CONFIG_ISR_STACK_SIZE=256
CONFIG_KERNEL_EVENT_LOGGER_BUFFER_SIZE=16
CONFIG_NUM_IRQS=3
CONFIG_KERNEL_EVENT_LOGGER=y
CONFIG_UART_CONSOLE_ON_DEV_NAME="UART_0"
CONFIG_UART_INTERRUPT_DRIVEN=y
CONFIG_CONSOLE_HANDLER=y
CONFIG_CONSOLE_HANDLER_SHELL=y
CONFIG_CONSOLE_HANDLER_SHELL_STACKSIZE=2000
```
